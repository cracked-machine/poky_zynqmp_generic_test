## layers/meta-test/conf/machine/custom_dts.conf
```bitbake
#@TYPE: Machine
#@NAME: Custom machine 
#@DESCRIPTION: Custom machine example


require conf/machine/zynqmp-generic.conf

# set the basic variant
SOC_VARIANT = "cg"

# Add override for our custom board dtsi that was patched into DTG (layers/meta-test/recipes-bsp/device-tree/device-tree.bbappend)
YAML_DT_BOARD_FLAGS:custom_dts = "{BOARD zynqmp-custom}"
# Select the custom board to use with DTG
MACHINEOVERRIDES .= ":custom_dts"


DL_DIR ?= "${TOPDIR}/../downloads"
SSTATE_DIR ?= "${TOPDIR}/../sstate-cache"

PACKAGE_CLASSES ?= "package_rpm"

#
# Extra image configuration defaults
#
# The EXTRA_IMAGE_FEATURES variable allows extra packages to be added to the generated
# images. Some of these options are added to certain image types automatically. The
# variable can contain the following options:
#  "dbg-pkgs"       - add -dbg packages for all installed packages
#                     (adds symbol information for debugging/profiling)
#  "src-pkgs"       - add -src packages for all installed packages
#                     (adds source code for debugging)
#  "dev-pkgs"       - add -dev packages for all installed packages
#                     (useful if you want to develop against libs in the image)
#  "ptest-pkgs"     - add -ptest packages for all ptest-enabled packages
#                     (useful if you want to run the package test suites)
#  "tools-sdk"      - add development tools (gcc, make, pkgconfig etc.)
#  "tools-debug"    - add debugging tools (gdb, strace)
#  "eclipse-debug"  - add Eclipse remote debugging support
#  "tools-profile"  - add profiling tools (oprofile, lttng, valgrind)
#  "tools-testapps" - add useful testing tools (ts_print, aplay, arecord etc.)
#  "debug-tweaks"   - make an image suitable for development
#                     e.g. ssh root access has a blank password
# There are other application targets that can be used here too, see
# meta/classes/image.bbclass and meta/classes/core-image.bbclass for more details.
# We default to enabling the debugging tweaks.
EXTRA_IMAGE_FEATURES ?= "debug-tweaks  ssh-server-openssh"
USER_CLASSES ?= "buildstats"


#IMAGE_CLASSES += "testimage testsdk"
#TESTIMAGE_AUTO:qemuall = "1"

PATCHRESOLVE = "noop"

BB_DISKMON_DIRS ??= "\
    STOPTASKS,${TMPDIR},1G,100K \
    STOPTASKS,${DL_DIR},1G,100K \
    STOPTASKS,${SSTATE_DIR},1G,100K \
    STOPTASKS,/tmp,100M,100K \
    ABORT,${TMPDIR},100M,1K \
    ABORT,${DL_DIR},100M,1K \
    ABORT,${SSTATE_DIR},100M,1K \
    ABORT,/tmp,10M,1K"


# BB_SIGNATURE_HANDLER = "OEEquivHash"
# BB_HASHSERVE = "auto"
# BB_HASHSERVE_UPSTREAM = "hashserv.yocto.io:80"


PACKAGECONFIG:append:pn-qemu-system-native = " sdl"


CONF_VERSION = "2"


LICENSE_FLAGS_WHITELIST:append = " xilinx" 

KERNEL_CLASSES:append = " kernel-fitimage"
KERNEL_IMAGETYPES:append = " fitImage"

# Configure qemuboot.bbclass settings.
# QB settings can be checked at build/tmp/deploy/images/custom/core-image-minimal-custom.qemuboot.conf
# QB_CMDLINE_IP_SLIRP = "ip=172.17.0.3"
# QB_CMDLINE_IP_TAP = "ip=172.17.0.@CLIENT@::172.17.0.@GATEWAY@:255.255.0.0::eth0"

# enable non-root QEMU when using with container
QEMU_USE_SLIRP = "1"    
# You must give TEST_SERVER_IP when using SLIRP otherwise "-c testimage" and ssh will fail
# Note, this is the ip address of the container that we run Yocto in.
TEST_SERVER_IP = "172.17.0.2"   

# disable x server for CI use
TEST_RUNQEMUPARAMS = "nographic"

INHERIT += "testimage"
# run all applicable tests
TEST_SUITES = "ping"
# or run silly test
# TEST_SUITES = "myimage"
```
